/* Copyright (c) 2012-2013, The Linux Foundation. All rights reserved.
 * Copyright (c) 2013-2014 OPPO Mobile communication Corp.ltd.
 * Copyright (c) 2014, The CyanogenMod Project
 *
 * This program is free software; you can redistribute it and/or modify
 * it under the terms of the GNU General Public License version 2 and
 * only version 2 as published by the Free Software Foundation.
 *
 * This program is distributed in the hope that it will be useful,
 * but WITHOUT ANY WARRANTY; without even the implied warranty of
 * MERCHANTABILITY or FITNESS FOR A PARTICULAR PURPOSE.  See the
 * GNU General Public License for more details.
 */

&mdss_mdp {
	dsi_sharp_1080_cmd: qcom,mdss_dsi_sharp_1080p_cmd {
		compatible = "qcom,mdss-dsi-panel";
		status = "ok";
		qcom,cont-splash-enabled;
		qcom,mdss-dsi-panel-name = "sharp 1080p cmd mode dsi panel";
		qcom,mdss-dsi-panel-manufacture = "sharp";
		qcom,mdss-dsi-panel-version = "R63315";
		qcom,mdss-dsi-panel-controller = <&mdss_dsi0>;
		qcom,mdss-dsi-panel-type = "dsi_cmd_mode";
		qcom,mdss-dsi-panel-destination = "display_1";
		qcom,mdss-dsi-panel-framerate = <60>;
		qcom,mdss-dsi-virtual-channel-id = <0>;
		qcom,mdss-dsi-stream = <0>;
		qcom,mdss-dsi-panel-width = <1080>;
		qcom,mdss-dsi-panel-height = <1920>;
		qcom,mdss-dsi-h-front-porch = <140>;
		qcom,mdss-dsi-h-back-porch = <70>;
		qcom,mdss-dsi-h-pulse-width = <4>;
		qcom,mdss-dsi-h-sync-skew = <0>;
		qcom,mdss-dsi-v-back-porch = <6>;
		qcom,mdss-dsi-v-front-porch = <8>;
		qcom,mdss-dsi-v-pulse-width = <2>;
		qcom,mdss-dsi-h-left-border = <0>;
		qcom,mdss-dsi-h-right-border = <0>;
		qcom,mdss-dsi-v-top-border = <0>;
		qcom,mdss-dsi-v-bottom-border = <0>;
		qcom,mdss-dsi-bpp = <24>;
		qcom,mdss-dsi-color-order = <0>;
		qcom,mdss-dsi-underflow-color = <0x00>;
		qcom,mdss-dsi-border-color = <0>;
		qcom,mdss-dsi-on-command = [
			23 01 00 00 01 00 02 b0 04
			29 01 00 00 01 00 07 b3 04 00 00 22 00 00
			29 01 00 00 01 00 1f c7 02 12 1A 25 34 45 51 60 42 4C 55 60 64 6D 76 02 13 1B 25 31 3C 42 51 35 3D 45 57 5E 69 74
			29 01 00 00 01 00 14 c8 01 00 00 00 02 C8 00 00 00 00 02 C8 00 00 00 00 02 FC 00
			29 01 00 00 01 00 21 ca 01 80 90 80 80 80 A0 80 08 20 00 80 0A 4A 00 FF 00 FF 0C 0C 20 10 3F 3F 00 DF 10 10 3F 3F 3F 3F
			29 01 00 00 01 00 1a d3 1B 33 BB BB B3 33 33 33 00 01 00 A0 D8 A0 00 4D 39 33 3B 37 72 57 3D BF 99
			23 01 00 00 01 00 02 d6 01
			23 01 00 00 01 00 02 3a 77
			29 01 00 00 01 00 05 2a 00 00 04 37
			29 01 00 00 01 00 05 2b 00 00 07 7f
			15 01 00 00 01 00 02 35 00
			15 01 00 00 01 00 02 2c 00
			05 01 00 00 78 00 02 11 00
			05 01 00 00 78 00 02 29 00
			39 01 00 00 01 00 02 51 ff
			15 01 00 00 01 00 02 55 03
			15 01 00 00 01 00 02 53 2c];
		qcom,mdss-dsi-off-command = [
			15 01 00 00 01 00 02 53 00
			05 01 00 00 32 00 02 28 00
			05 01 00 00 78 00 02 10 00];
		qcom,mdss-dsi-on-command-state = "dsi_lp_mode";
		qcom,mdss-dsi-off-command-state = "dsi_hs_mode";
		qcom,mdss-dsi-h-sync-pulse = <1>;
		qcom,mdss-dsi-traffic-mode = "burst_mode";
		qcom,mdss-dsi-bllp-eof-power-mode;
		qcom,mdss-dsi-bllp-power-mode;
		qcom,mdss-dsi-lane-0-state;
		qcom,mdss-dsi-lane-1-state;
		qcom,mdss-dsi-lane-2-state;
		qcom,mdss-dsi-lane-3-state;
		qcom,mdss-dsi-te-pin-select = <1>;
		qcom,mdss-dsi-wr-mem-start = <0x2c>;
		qcom,mdss-dsi-wr-mem-continue = <0x3c>;
		qcom,mdss-dsi-te-dcs-command = <1>;
		qcom,mdss-dsi-te-check-enable;
		qcom,mdss-dsi-te-using-te-pin;
		qcom,mdss-dsi-panel-timings = [f9 3d 34 00 58 4d 36 3f 53 03 04 00];
		qcom,mdss-dsi-t-clk-post = <0x20>;
		qcom,mdss-dsi-t-clk-pre = <0x3e>;
		qcom,mdss-dsi-bl-min-level = <1>;
		qcom,mdss-dsi-bl-max-level = <255>;
		qcom,mdss-dsi-dma-trigger = "trigger_sw";
		qcom,mdss-dsi-mdp-trigger = "trigger_sw";
		qcom,mdss-dsi-bl-pmic-control-type = "bl_ctrl_wled";
		qcom,mdss-dsi-reset-sequence = <1 5>, <0 10>, <1 10>;
		qcom,mdss-dsi-cabc-off-command = [
			15 01 00 00 10 00 02 55 00
			05 01 00 00 10 00 02 29 00];
		qcom,mdss-dsi-cabc-ui-command = [
			15 01 00 00 10 00 02 55 01
			05 01 00 00 10 00 02 29 00];
		qcom,mdss-dsi-cabc-still-image-command = [
			15 01 00 00 10 00 02 55 02
			05 01 00 00 10 00 02 29 00];
		qcom,mdss-dsi-cabc-video-command = [
			15 01 00 00 10 00 02 55 03
			05 01 00 00 10 00 02 29 00];
	};
};
