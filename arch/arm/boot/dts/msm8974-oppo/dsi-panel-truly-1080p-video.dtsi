/* Copyright (c) 2012-2013, The Linux Foundation. All rights reserved.
 * Copyright (c) 2013-2014 OPPO Mobile communication Corp.ltd.
 * Copyright (c) 2014, The CyanogenMod Project
 *
 * This program is free software; you can redistribute it and/or modify
 * it under the terms of the GNU General Public License version 2 and
 * only version 2 as published by the Free Software Foundation.
 *
 * This program is distributed in the hope that it will be useful,
 * but WITHOUT ANY WARRANTY; without even the implied warranty of
 * MERCHANTABILITY or FITNESS FOR A PARTICULAR PURPOSE.  See the
 * GNU General Public License for more details.
 */

&mdss_mdp {
	dsi_truly_1080_vid: qcom,mdss_dsi_truly_1080p_video {
		compatible = "qcom,mdss-dsi-panel2";
		status = "ok";
		qcom,mdss-pan-physical-width-dimension = <68>;
		qcom,mdss-pan-physical-height-dimension = <121>;
		qcom,mdss-dsi-panel-name = "LG 1080p video mode dsi panel";
		qcom,mdss-dsi-panel-manufacture = "LG";
		qcom,mdss-dsi-panel-version = "R63315";
		qcom,mdss-dsi-panel-controller = <&mdss_dsi0>;
		qcom,mdss-dsi-panel-type = "dsi_video_mode";
		qcom,mdss-dsi-panel-destination = "display_1";
		qcom,mdss-dsi-panel-framerate = <60>;
		qcom,mdss-dsi-virtual-channel-id = <0>;
		qcom,mdss-dsi-stream = <0>;
		qcom,mdss-dsi-panel-width = <1080>;
		qcom,mdss-dsi-panel-height = <1920>;
		qcom,mdss-dsi-h-front-porch = <90>;
		qcom,mdss-dsi-h-back-porch = <45>;
		qcom,mdss-dsi-h-pulse-width = <8>;
		qcom,mdss-dsi-h-sync-skew = <0>;
		qcom,mdss-dsi-v-back-porch = <6>;
		qcom,mdss-dsi-v-front-porch = <8>;
		qcom,mdss-dsi-v-pulse-width = <2>;
		qcom,mdss-dsi-h-left-border = <0>;
		qcom,mdss-dsi-h-right-border = <0>;
		qcom,mdss-dsi-v-top-border = <0>;
		qcom,mdss-dsi-v-bottom-border = <0>;
		qcom,mdss-dsi-bpp = <24>;
		qcom,mdss-dsi-color-order = <0>;
		qcom,mdss-dsi-underflow-color = <0xff>;
		qcom,mdss-dsi-border-color = <0>;
		qcom,mdss-dsi-on-command = [
			05 01 00 00 78 00 02 11 00
			23 01 00 00 01 00 02 b0 04
			05 01 00 00 01 00 02 00 00
			05 01 00 00 01 00 02 00 00
			29 01 00 00 01 00 07 b3 14 00 00 00 00 00
			29 01 00 00 01 00 03 b6 3a d3
			29 01 00 00 01 00 02 c0 00
			29 01 00 00 01 00 23 c1 84 60 10 eb ff 6f ce ff ff 17 12 58 73 ae 31 20 c6 ff ff 1f f3 ff 5f 10 10 10 10 00 62 01 22 22 00 01
			29 01 00 00 01 00 08 c2 31 f7 80 08 08 80 00
			29 01 00 00 01 00 17 c4 70 00 00 00 00 00 00 00 00 0c 06 00 00 00 00 00 00 00 00 00 0c 06
			29 01 00 00 01 00 29 c6 c8 08 67 08 67 00 00 00 00 00 00 00 00 00 00 00 00 16 18 08 c8 08 67 08 67 00 00 00 00 00 00 00 00 00 00 00 00 16 18 08
			29 01 00 00 01 00 1f c7 00 11 19 24 2c 3d 46 53 37 42 50 60 66 6a 70 00 11 19 24 2c 3d 46 53 37 42 50 60 66 6a 70
			29 01 00 00 01 00 14 c8 00 00 00 00 00 fc 00 00 00 00 00 fc 00 00 00 00 00 fc 00
			23 01 00 00 01 00 09 cb 31 fc 3f 8c 00 00 00 00
			29 01 00 00 01 00 0b d0 11 81 bb 19 99 4c 19 19 0c 00
			29 01 00 00 01 00 1a d3 1b 33 bb bb b3 33 33 33 01 01 00 a0 d8 a0 0d 48 48 44 3b 22 72 07 3d bf 33
			29 01 00 00 01 00 08 d5 06 00 00 01 4e 01 4e
			29 01 00 00 01 00 08 d5 06 00 00 01 4e 01 4e
			23 01 00 00 01 00 02 cc 0b
			29 01 00 00 01 00 08 ce 00 01 00 c1 00 00 00
			29 01 00 00 01 00 02 d6 01
			15 01 00 00 01 00 02 53 24
			29 01 00 00 01 00 08 ce 00 01 00 c1 00 00 00
			15 01 00 00 20 00 02 53 24
			39 01 00 00 01 00 02 51 ff
			15 01 00 00 01 00 02 35 00];
		qcom,mdss-dsi-off-command = [
			05 01 00 00 32 00 02 28 00
			05 01 00 00 78 00 02 10 00];
		qcom,mdss-dsi-on-command-state = "dsi_lp_mode";
		qcom,mdss-dsi-off-command-state = "dsi_hs_mode";
		qcom,mdss-dsi-h-sync-pulse = <1>;
		qcom,mdss-dsi-traffic-mode = "burst_mode";
		qcom,mdss-dsi-lane-map = "lane_map_0123";
		qcom,mdss-dsi-bllp-eof-power-mode;
		qcom,mdss-dsi-bllp-power-mode;
		qcom,mdss-dsi-lane-0-state;
		qcom,mdss-dsi-lane-1-state;
		qcom,mdss-dsi-lane-2-state;
		qcom,mdss-dsi-lane-3-state;
		qcom,mdss-dsi-panel-timings = [f9 3d 34 00 58 4d 36 3f 53 03 04 00];
		qcom,mdss-dsi-t-clk-post = <0x1e>;
		qcom,mdss-dsi-t-clk-pre = <0x38>;
		qcom,mdss-dsi-bl-min-level = <1>;
		qcom,mdss-dsi-bl-max-level = <255>;
		qcom,mdss-dsi-dma-trigger = "trigger_sw";
		qcom,mdss-dsi-mdp-trigger = "none";
		qcom,mdss-dsi-bl-pmic-control-type = "bl_ctrl_wled";
		qcom,mdss-dsi-reset-sequence = <1 5>, <0 10>, <1 10>;
		qcom,cont-splash-enabled;
	};
};
