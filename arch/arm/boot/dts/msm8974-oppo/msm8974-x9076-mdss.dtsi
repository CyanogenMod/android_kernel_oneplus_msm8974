/* Copyright (c) 2012-2013, The Linux Foundation. All rights reserved.
 *
 * This program is free software; you can redistribute it and/or modify
 * it under the terms of the GNU General Public License version 2 and
 * only version 2 as published by the Free Software Foundation.
 *
 * This program is distributed in the hope that it will be useful,
 * but WITHOUT ANY WARRANTY; without even the implied warranty of
 * MERCHANTABILITY or FITNESS FOR A PARTICULAR PURPOSE.  See the
 * GNU General Public License for more details.
 */

&soc {
	qcom,mdss_mdp@fd900000 {
		qcom,mdss-ib-factor = <15 5>;	/* 3 times */

		qcom,mdss_fb_primary {
			qcom,mdss-mixer-swap;
			qcom,mdss-fb-split = <720 720>;
		};
	};

	qcom,mdss_dsi@fd922800 {
		qcom,platform-lcd-5v-en-gpio = <&msmgpio 46 0>;
	};
};
