/* Copyright (c) 2012-2013, The Linux Foundation. All rights reserved.
 *
 * This program is free software; you can redistribute it and/or modify
 * it under the terms of the GNU General Public License version 2 and
 * only version 2 as published by the Free Software Foundation.
 *
 * This program is distributed in the hope that it will be useful,
 * but WITHOUT ANY WARRANTY; without even the implied warranty of
 * MERCHANTABILITY or FITNESS FOR A PARTICULAR PURPOSE.  See the
 * GNU General Public License for more details.
 */

&soc {
	i2c_6: i2c@f9928000 {
		cell-index = <6>;
		compatible = "qcom,i2c-qup";
		reg = <0xf9928000 0x1000>;
		#address-cells = <1>;
		#size-cells = <0>;
		reg-names = "qup_phys_addr";
		interrupts = <0 100 0>;
		interrupt-names = "qup_err_intr";
		qcom,i2c-bus-freq = <100000>;
		qcom,i2c-src-freq = <19200000>;
		qcom,scl-gpio = <&msmgpio 30 0>;
		qcom,sda-gpio = <&msmgpio 29 0>;
		qcom,active-only;
		qcom,master-id = <86>;

		pn544-nxp-nfc@28 {
			compatible = "pn544,nxp-nfc";
			reg = <0x28>;
			interrupt-parent = <&msmgpio>;
			interrupts = <59 0x4>;
			pn544,irq-gpio = <&msmgpio 59 0x00>;
			pn544,enable-gpio = <&msmgpio 13 0x00>;
			pn544,update-gpio = <&msmgpio 12 0x00>;
		};
	};
};
