/* Copyright (c) 2012-2013, The Linux Foundation. All rights reserved.
 * Copyright (c) 2013-2014 OPPO Mobile communication Corp.ltd.
 * Copyright (c) 2014, The CyanogenMod Project
 *
 * This program is free software; you can redistribute it and/or modify
 * it under the terms of the GNU General Public License version 2 and
 * only version 2 as published by the Free Software Foundation.
 *
 * This program is distributed in the hope that it will be useful,
 * but WITHOUT ANY WARRANTY; without even the implied warranty of
 * MERCHANTABILITY or FITNESS FOR A PARTICULAR PURPOSE.  See the
 * GNU General Public License for more details.
 */
/include/ "dsi-panel-jdi-1080p-cmd.dtsi"
/include/ "dsi-panel-jdi-1080p-video.dtsi"
/include/ "dsi-panel-sharp-1080p-cmd.dtsi"
/include/ "dsi-panel-truly-1080p-cmd.dtsi"
/include/ "dsi-panel-truly-1080p-video.dtsi"

/include/ "dsi-panel-jdi-1440p-video.dtsi"
/include/ "dsi-panel-rsp-1440p-cmd.dtsi"
/include/ "dsi-panel-rsp-1440p-video.dtsi"
