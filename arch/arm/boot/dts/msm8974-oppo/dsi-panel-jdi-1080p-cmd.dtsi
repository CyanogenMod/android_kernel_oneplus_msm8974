/* Copyright (c) 2012-2013, The Linux Foundation. All rights reserved.
 * Copyright (c) 2013-2014 OPPO Mobile communication Corp.ltd.
 * Copyright (c) 2014, The CyanogenMod Project
 *
 * This program is free software; you can redistribute it and/or modify
 * it under the terms of the GNU General Public License version 2 and
 * only version 2 as published by the Free Software Foundation.
 *
 * This program is distributed in the hope that it will be useful,
 * but WITHOUT ANY WARRANTY; without even the implied warranty of
 * MERCHANTABILITY or FITNESS FOR A PARTICULAR PURPOSE.  See the
 * GNU General Public License for more details.
 */

&mdss_mdp {
	dsi_jdi_1080_cmd: qcom,mdss_dsi_jdi_1080p_cmd {
		compatible = "qcom,mdss-dsi-panel";
		status = "ok";
		qcom,mdss-pan-physical-width-dimension = <68>;
		qcom,mdss-pan-physical-height-dimension = <121>;
		qcom,mdss-dsi-panel-name = "jdi 1080p cmd mode dsi panel";
		qcom,mdss-dsi-panel-manufacture = "JDI";
		qcom,mdss-dsi-panel-version = "R63417";
		qcom,mdss-dsi-panel-controller = <&mdss_dsi0>;
		qcom,mdss-dsi-panel-type = "dsi_cmd_mode";
		qcom,mdss-dsi-panel-destination = "display_1";
		qcom,mdss-dsi-panel-framerate = <63>;
		qcom,mdss-dsi-virtual-channel-id = <0>;
		qcom,mdss-dsi-stream = <0>;
		qcom,mdss-dsi-panel-width = <1080>;
		qcom,mdss-dsi-panel-height = <1920>;
		qcom,mdss-dsi-h-front-porch = <140>;
		qcom,mdss-dsi-h-back-porch = <70>;
		qcom,mdss-dsi-h-pulse-width = <4>;
		qcom,mdss-dsi-h-sync-skew = <0>;
		qcom,mdss-dsi-v-back-porch = <6>;
		qcom,mdss-dsi-v-front-porch = <8>;
		qcom,mdss-dsi-v-pulse-width = <2>;
		qcom,mdss-dsi-h-left-border = <0>;
		qcom,mdss-dsi-h-right-border = <0>;
		qcom,mdss-dsi-v-top-border = <0>;
		qcom,mdss-dsi-v-bottom-border = <0>;
		qcom,mdss-dsi-bpp = <24>;
		qcom,mdss-dsi-underflow-color = <0x00>;
		qcom,mdss-dsi-border-color = <0>;
		qcom,mdss-dsi-on-command = [
			39 01 00 00 01 00 05 2a 00 00 04 37
			39 01 00 00 01 00 05 2b 00 00 07 7f
			23 01 00 00 01 00 02 b0 04
			29 01 00 00 01 00 1f c7 00 0b 10 19 27 33 3d 4c 32 39 45 57 6a 74 7f 00 0b 10 19 27 33 3d 4c 32 39 45 57 6a 74 7f
			29 01 00 00 01 00 18 ce 75 40 43 49 55 62 71 82 94 a8 b9 cb db e9 f5 fc ff 04 00 04 04 44 20
			29 01 00 00 01 00 07 b8 03 90 1e 10 1e 32
			29 01 00 00 01 00 07 b9 03 82 3c 10 3c 87
			29 01 00 00 01 00 07 ba 03 78 64 10 64 b4
			23 01 00 00 00 00 02 d6 01
			23 01 00 00 01 00 02 b0 03
			39 01 00 00 01 00 02 51 ff
			15 01 00 00 01 00 02 55 03
			15 01 00 00 01 00 02 53 2c
			05 01 00 00 78 00 02 11 00
			15 01 00 00 11 00 02 36 00
			15 01 00 00 01 00 02 3a 77
			39 01 00 00 01 00 03 44 00 00
			15 01 00 00 01 00 02 35 00];
		qcom,mdss-dsi-off-command = [
			05 01 00 00 32 00 02 28 00
			05 01 00 00 78 00 02 10 00];
		qcom,mdss-dsi-calibration-command = [
			23 01 00 00 01 00 02 b0 04
			29 01 00 00 01 00 14 c8 01 0A FD 03 01 E8 00 00 03 FC F5 A1 00 00 01 FD 06 FC 00
			29 01 00 00 01 00 02 ca 00];
		qcom,mdss-dsi-on-command-state = "dsi_lp_mode";
		qcom,mdss-dsi-off-command-state = "dsi_hs_mode";
		qcom,mdss-dsi-h-sync-pulse = <1>;
		qcom,mdss-dsi-traffic-mode = "burst_mode";
		qcom,mdss-dsi-bllp-eof-power-mode;
		qcom,mdss-dsi-bllp-power-mode;
		qcom,mdss-dsi-lane-0-state;
		qcom,mdss-dsi-lane-1-state;
		qcom,mdss-dsi-lane-2-state;
		qcom,mdss-dsi-lane-3-state;
		qcom,mdss-dsi-te-pin-select = <1>;
		qcom,mdss-dsi-wr-mem-start = <0x2c>;
		qcom,mdss-dsi-wr-mem-continue = <0x3c>;
		qcom,mdss-dsi-te-dcs-command = <1>;
		qcom,mdss-dsi-te-check-enable;
		qcom,mdss-dsi-te-using-te-pin;
		qcom,mdss-dsi-panel-timings = [f9 3d 34 00 58 4d 36 3f 53 03 04 00];
		qcom,mdss-dsi-t-clk-post = <0x20>;
		qcom,mdss-dsi-t-clk-pre = <0x3e>;
		qcom,mdss-dsi-bl-min-level = <1>;
		qcom,mdss-dsi-bl-max-level = <255>;
		qcom,mdss-dsi-bl-sre-level = <254>;
		qcom,mdss-dsi-bl-cabc-max-level = <225>;
		qcom,mdss-dsi-dma-trigger = "trigger_sw";
		qcom,mdss-dsi-mdp-trigger = "trigger_sw";
		qcom,mdss-dsi-bl-pmic-control-type = "bl_ctrl_wled";
		qcom,mdss-dsi-reset-sequence = <1 5>, <0 10>, <1 10>;
		qcom,mdss-dsi-cabc-off-command = [15 01 00 00 10 00 02 55 00
			05 01 00 00 10 00 02 29 00];
		qcom,mdss-dsi-cabc-ui-command = [15 01 00 00 10 00 02 55 01
			05 01 00 00 10 00 02 29 00];
		qcom,mdss-dsi-cabc-still-image-command = [15 01 00 00 10 00 02 55 02
			05 01 00 00 10 00 02 29 00];
		qcom,mdss-dsi-cabc-video-command = [15 01 00 00 10 00 02 55 03
			05 01 00 00 10 00 02 29 00];
		qcom,mdss-dsi-sre-ui-command = [15 01 00 00 10 00 02 55 60
			05 01 00 00 10 00 02 29 00];
		qcom,mdss-dsi-color-enhance-on-command = [23 01 00 00 01 00 02 b0 04
			29 01 00 00 10 00 21 ca 01
			02 9a a4 b8 b4 b0 a4 08 28 05 87 b0 50 01 ff 05 f8 0c 0c 50 40 13 13 f0 08 10 10 3f 3f 3f 3f
			23 01 00 00 01 00 02 b0 03];
		qcom,mdss-dsi-color-enhance-off-command = [23 01 00 00 01 00 02 b0 04
			29 01 00 00 10 00 21 ca 00
			80 80 80 80 80 80 80 08 20 80 80 0a 4a 37 a0 55 f8 0c 0c 20 10 3f 3f 00 00 10 10 3f 3f 3f 3f
			23 01 00 00 01 00 02 b0 03];
		qcom,mdss-dsi-gamma1 = [23 01 00 00 01 00 02 b0 04
			29 01 00 00 01 00 14 c8 01 0A FD 03 01 E8 00 00 03 FC F5 A1 00 00 01 FD 06 FC 00
			23 01 00 00 00 00 02 d6 01
			23 01 00 00 01 00 02 b0 03];
		qcom,mdss-dsi-gamma2 = [23 01 00 00 01 00 02 b0 04
			29 01 00 00 01 00 14 c8 01 00 F0 F4 00 D5 00 00 E8 E6 02 BA 00 00 00 00 00 00 00
			23 01 00 00 00 00 02 d6 01
			23 01 00 00 01 00 02 b0 03];
		qcom,mdss-dsi-gamma3 = [23 01 00 00 01 00 02 b0 04
			29 01 00 00 01 00 14 c8 01 00 F0 F4 00 D5 00 00 00 00 00 00 00 00 F0 F0 00 FC 00
			23 01 00 00 00 00 02 d6 01
			23 01 00 00 01 00 02 b0 03];
		qcom,mdss-dsi-gamma4 = [23 01 00 00 01 00 02 b0 04
			29 01 00 00 01 00 14 c8 01 00 00 00 00 00 00 00 E8 E6 02 BA 00 00 F0 F0 00 FC 00
			23 01 00 00 00 00 02 d6 01
			23 01 00 00 01 00 02 b0 03];
		qcom,cont-splash-enabled;
		qcom,partial-update-enabled;
		qcom,panel-roi-alignment = <900 4 2 4 540 20>;
		qcom,ulps-enabled;
	};
};
