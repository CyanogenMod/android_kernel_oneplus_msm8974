/* Copyright (c) 2013, The Linux Foundation. All rights reserved.
 *
 * This program is free software; you can redistribute it and/or modify
 * it under the terms of the GNU General Public License version 2 and
 * only version 2 as published by the Free Software Foundation.
 *
 * This program is distributed in the hope that it will be useful,
 * but WITHOUT ANY WARRANTY; without even the implied warranty of
 * MERCHANTABILITY or FITNESS FOR A PARTICULAR PURPOSE.  See the
 * GNU General Public License for more details.
 */

/*---------------------------------------------------------------------------
 * This file is autogenerated file using gcdb parser. Please do not edit it.
 * Update input XML file to add a new entry or update variable in this file
 * VERSION = "1.0"
 *---------------------------------------------------------------------------*/
&mdss_mdp {
	dsi_rsp_1440_cmd: qcom,dsi_rsp_1440p_cmd_0 {
		compatible = "qcom,mdss-dsi-panel";
		status = "ok";
		qcom,cont-splash-enabled;
		qcom,mdss-dsi-panel-name = "rsp 1440p cmd mode dsi panel1";
		qcom,mdss-dsi-panel-manufacture = "JDI_RSP";
		qcom,mdss-dsi-panel-version = "R63419";
		qcom,mdss-dsi-panel-controller = <&mdss_dsi0>;
		qcom,mdss-dsi-panel-type = "dsi_cmd_mode";
		qcom,mdss-dsi-panel-destination = "display_1";
		qcom,mdss-dsi-panel-framerate = <55>;
		qcom,mdss-dsi-virtual-channel-id = <0>;
		qcom,mdss-dsi-stream = <0>;
		qcom,mdss-dsi-panel-width = <720>;
		qcom,mdss-dsi-panel-height = <2560>;
		qcom,mdss-dsi-h-front-porch = <280>;
		qcom,mdss-dsi-h-back-porch = <34>;
		qcom,mdss-dsi-h-pulse-width = <14>;
		qcom,mdss-dsi-h-sync-skew = <0>;
		qcom,mdss-dsi-v-back-porch = <2>;
		qcom,mdss-dsi-v-front-porch = <8>;
		qcom,mdss-dsi-v-pulse-width = <2>;
		qcom,mdss-dsi-h-left-border = <0>;
		qcom,mdss-dsi-h-right-border = <0>;
		qcom,mdss-dsi-v-top-border = <0>;
		qcom,mdss-dsi-v-bottom-border = <0>;
		qcom,mdss-dsi-bpp = <24>;
		qcom,mdss-dsi-color-order = <0>;
		qcom,mdss-dsi-underflow-color = <0x00>;
		qcom,mdss-dsi-border-color = <0>;
		qcom,mdss-dsi-on-command = [
			39 01 00 00 01 00 05 2a 00 00 05 9f
			39 01 00 00 01 00 05 2b 00 00 09 ff
			23 01 00 00 01 00 02 b0 04
			29 01 00 00 01 00 14 c8 01 00 00 00 00 FC 00 00 00 00 00 C0 00 00 00 00 00 FC 00
			29 01 00 00 01 00 25 ca 81 95 95 80 80 A0 80 08 20 80 ff 00 00 00 00 00 00 00 0A 4A 37 A0 55 F8 0C 0C 20 10 3F 3F 10 10 3F 3F 3F 3F
			29 01 00 00 01 00 1A CE 55 40 49 53 59 5E 63 68 6E 74 7E 8A 98 A8 BB D0 FF 04 00 04 04 00 00 69 5A
			29 01 00 00 01 00 08 B8 57 3C 19 1E 0A 50 50
			29 01 00 00 01 00 08 B9 6F 3C 28 3C 14 C8 C8
			29 01 00 00 01 00 08 BA B5 32 41 64 23 A0 A0
			23 01 00 00 00 00 02 d6 01
			23 01 00 00 01 00 02 b0 03
			15 01 00 00 78 00 02 11 00
			39 01 00 00 01 00 03 44 00 00
			15 01 00 00 01 00 02 35 00
			15 01 00 00 01 00 02 36 00
			15 01 00 00 01 00 02 3a 77
			39 01 00 00 01 00 02 51 ff
			15 01 00 00 01 00 02 53 2c
			15 01 00 00 01 00 02 55 03
			05 01 00 00 14 00 02 29 00];
		qcom,mdss-dsi-off-command = [
			05 01 00 00 32 00 02 28 00
			05 01 00 00 78 00 02 10 00];
		qcom,mdss-dsi-on-command-state = "dsi_lp_mode";
		qcom,mdss-dsi-off-command-state = "dsi_hs_mode";
		qcom,mdss-dsi-h-sync-pulse = <0>;
		qcom,mdss-dsi-traffic-mode = "burst_mode";
		qcom,mdss-dsi-lane-map = <0>;
		qcom,mdss-dsi-bllp-eof-power-mode;
		qcom,mdss-dsi-bllp-power-mode;
		/* qcom,mdss-dsi-hfp-power-mode;
		qcom,mdss-dsi-panel-broadcast-mode; */
		qcom,mdss-dsi-lane-0-state;
		qcom,mdss-dsi-lane-1-state;
		qcom,mdss-dsi-lane-2-state;
		qcom,mdss-dsi-lane-3-state;
		qcom,mdss-dsi-te-pin-select = <1>;
		qcom,mdss-dsi-te-v-sync-rd-ptr-irq-line = <0x2c>;
		qcom,mdss-dsi-te-v-sync-continue-lines = <0x3c>;
		qcom,mdss-dsi-te-dcs-command = <1>;
		qcom,mdss-dsi-te-check-enable;
		qcom,mdss-dsi-te-using-te-pin;
		/*qcom,mdss-dsi-panel-timings = [ef 38 25 00 67 70 29 3c 2c 03 04 00];*/
		qcom,mdss-dsi-panel-timings = [e6 38 26 00 68 aa 2a 3a 2c 03 04 00];
		qcom,mdss-dsi-t-clk-post = <0x20>;
		qcom,mdss-dsi-t-clk-pre = <0x3e>;
		qcom,mdss-dsi-bl-min-level = <1>;
		qcom,mdss-dsi-bl-max-level = <255>;
		qcom,mdss-dsi-dma-trigger = "trigger_sw";
		qcom,mdss-dsi-mdp-trigger = "trigger_sw";
		qcom,mdss-dsi-bl-pmic-control-type = "bl_ctrl_wled";
		qcom,mdss-dsi-reset-sequence = <1 20>, <0 200>, <1 20>;
		qcom,mdss-dsi-cabc-off-command = [
			15 01 00 00 10 00 02 55 00
			05 01 00 00 10 00 02 29 00];
		qcom,mdss-dsi-cabc-ui-command = [
			15 01 00 00 10 00 02 55 01
			05 01 00 00 10 00 02 29 00];
		qcom,mdss-dsi-cabc-still-image-command = [
			15 01 00 00 10 00 02 55 02
			05 01 00 00 10 00 02 29 00];
		qcom,mdss-dsi-cabc-video-command = [
			15 01 00 00 10 00 02 55 03
			05 01 00 00 10 00 02 29 00];
	};

	dsi_rsp_1440_cmd2: qcom,dsi_rsp_1440p_cmd_1 {
		compatible = "qcom,mdss-dsi-panel2";
		status = "ok";
		qcom,cont-splash-enabled;
		qcom,mdss-dsi-panel-name = "rsp 1440p cmd mode dsi panel2";
		qcom,mdss-dsi-panel-manufacture = "JDI_RSP";
		qcom,mdss-dsi-panel-version = "R63419";
		qcom,mdss-dsi-panel-controller = <&mdss_dsi1>;
		qcom,mdss-dsi-panel-type = "dsi_cmd_mode";
		qcom,mdss-dsi-panel-destination = "display_2";
		qcom,mdss-dsi-panel-framerate = <55>;
		qcom,mdss-dsi-virtual-channel-id = <0>;
		qcom,mdss-dsi-stream = <0>;
		qcom,mdss-dsi-panel-width = <720>;
		qcom,mdss-dsi-panel-height = <2560>;
		qcom,mdss-dsi-h-front-porch = <280>;
		qcom,mdss-dsi-h-back-porch = <34>;
		qcom,mdss-dsi-h-pulse-width = <14>;
		qcom,mdss-dsi-h-sync-skew = <0>;
		qcom,mdss-dsi-v-back-porch = <2>;
		qcom,mdss-dsi-v-front-porch = <8>;
		qcom,mdss-dsi-v-pulse-width = <2>;
		qcom,mdss-dsi-h-left-border = <0>;
		qcom,mdss-dsi-h-right-border = <0>;
		qcom,mdss-dsi-v-top-border = <0>;
		qcom,mdss-dsi-v-bottom-border = <0>;
		qcom,mdss-dsi-bpp = <24>;
		qcom,mdss-dsi-color-order = <0>;
		qcom,mdss-dsi-on-command = [
			39 01 00 00 01 00 05 2a 00 00 05 9f
			39 01 00 00 01 00 05 2b 00 00 09 ff
			23 01 00 00 01 00 02 b0 04
			29 01 00 00 01 00 14 c8 01 00 00 00 00 FC 00 00 00 00 00 C0 00 00 00 00 00 FC 00
			29 01 00 00 01 00 25 ca 81 95 95 80 80 A0 80 08 20 80 ff 00 00 00 00 00 00 00 0A 4A 37 A0 55 F8 0C 0C 20 10 3F 3F 10 10 3F 3F 3F 3F
			29 01 00 00 01 00 1A CE 55 40 49 53 59 5E 63 68 6E 74 7E 8A 98 A8 BB D0 FF 04 00 04 04 00 00 69 5A
			29 01 00 00 01 00 08 B8 57 3C 19 1E 0A 50 50
			29 01 00 00 01 00 08 B9 6F 3C 28 3C 14 C8 C8
			29 01 00 00 01 00 08 BA B5 32 41 64 23 A0 A0
			23 01 00 00 00 00 02 d6 01
			23 01 00 00 01 00 02 b0 03
			15 01 00 00 78 00 02 11 00
			39 01 00 00 01 00 03 44 00 00
			15 01 00 00 01 00 02 35 00
			15 01 00 00 01 00 02 36 00
			15 01 00 00 01 00 02 3a 77
			39 01 00 00 01 00 02 51 ff
			15 01 00 00 01 00 02 53 2c
			15 01 00 00 01 00 02 55 03
			05 01 00 00 14 00 02 29 00];
		qcom,mdss-dsi-off-command = [
			05 01 00 00 32 00 02 28 00
			05 01 00 00 78 00 02 10 00];
		qcom,mdss-dsi-underflow-color = <0x00>;
		qcom,mdss-dsi-border-color = <0>;
		qcom,mdss-dsi-h-sync-pulse = <0>;
		qcom,mdss-dsi-traffic-mode = "burst_mode";
		qcom,mdss-dsi-lane-map = <0>;
		qcom,mdss-dsi-bllp-eof-power-mode;
		qcom,mdss-dsi-bllp-power-mode;
		/* qcom,mdss-dsi-hfp-power-mode;
		qcom,mdss-dsi-panel-broadcast-mode; */
		qcom,mdss-dsi-lane-0-state;
		qcom,mdss-dsi-lane-1-state;
		qcom,mdss-dsi-lane-2-state;
		qcom,mdss-dsi-lane-3-state;
		qcom,mdss-dsi-te-pin-select = <1>;
		qcom,mdss-dsi-te-v-sync-rd-ptr-irq-line = <0x2c>;
		qcom,mdss-dsi-te-v-sync-continue-lines = <0x3c>;
		qcom,mdss-dsi-te-dcs-command = <1>;
		qcom,mdss-dsi-te-check-enable;
		qcom,mdss-dsi-te-using-te-pin;
		/*qcom,mdss-dsi-panel-timings = [ef 38 25 00 67 70 29 3c 2c 03 04 00];*/
		qcom,mdss-dsi-panel-timings = [e6 38 26 00 68 aa 2a 3a 2c 03 04 00];
		qcom,mdss-dsi-t-clk-post = <0x20>;
		qcom,mdss-dsi-t-clk-pre = <0x3e>;
		qcom,mdss-dsi-bl-min-level = <1>;
		qcom,mdss-dsi-bl-max-level = <255>;
		qcom,mdss-dsi-dma-trigger = "trigger_sw";
		qcom,mdss-dsi-mdp-trigger = "none";
		qcom,mdss-dsi-bl-pmic-control-type = "bl_ctrl_wled";
		qcom,mdss-dsi-reset-sequence = <1 20>, <0 200>, <1 20>;
	};
};
