## Documentation/devicetree/bindings/usb/dwc3.txt
```
synopsys DWC3 CORE

DWC3- USB3 CONTROLLER

Required properties:
 - compatible: must be "synopsys,dwc3"
 - reg : Address and length of the register set for the device
 - interrupts: Interrupts used by the dwc3 controller.
 - interrupt-names : Required interrupt resource entries are:
	"irq" : Interrupt for DWC3 core
	"otg_irq" : Interrupt for DWC3 core's OTG Events

Optional properties:
 - tx-fifo-resize: determines if the FIFO *has* to be reallocated.
 - host-only-mode: if present then dwc3 should be run in HOST only mode.
 - snps,hsphy-auto-suspend-disable: If present, auto suspend feature is not enabled with hsusb phy.
 - snps,ssphy-clear-auto-suspend-on-disconnect: If present, clear auto suspend feaure with ssusb phy
   during cable disconnect.
 - snps,usb3-u1u2-disable: If present, disable u1u2 low power modes for DWC3 core controller in SS mode.

This is usually a subnode to DWC3 glue to which it is connected.

dwc3@4a030000 {
	compatible = "synopsys,dwc3";
	reg = <0x4a030000 0xcfff>;
	interrupts = <0 92 4>, <0 179 0>;
	interrupt-names = "irq", "otg_irq";
	tx-fifo-resize;
	snps,hsphy-auto-suspend-disable;
	snps,ssphy-clear-auto-suspend-on-disconnect;
	snps,usb3-u1u2-disable;
};
```

## arch/arm/hotplug/Kconfig
```kconfig
config INTELLI_PLUG
        bool "Enable intelli-plug cpu hotplug driver"
        default n
        help
          Generic Intelli-plug cpu hotplug driver for ARM SOCs
```

## arch/arm/mach-msm/oppo/Kconfig
```kconfig
config MACH_OPPO
	bool
	depends on ARCH_MSM

config MACH_X9007
	depends on ARCH_MSM8974
	select MACH_OPPO
	bool "MSM8974 X9007"
	help
	  Support for Oppo X9007 Find7 variants.

menu "Oppo board selection"

config MACH_FIND7
	select MACH_X9007
	bool "Find7"
	help
	  Support for the Find7 variant

config MACH_FIND7OP
	select MACH_X9007
	bool "Oneplus"
	help
	  Support for the Oneplus variant

endmenu

menu "Oppo specific options"

config OPPO_TRACE
	tristate "Oppo trace driver"
	default n
	help
	  Say Y to enable Oppo trace driver

config OPPO_DEVICE_INFO
	bool "Oppo device info driver"
	default y if MACH_OPPO
	help
	  Say Y to enable Oppo device info driver

endmenu
```

## backports/Kconfig
```kconfig
config BACKPORT_INTEGRATE
	bool
	def_bool y

config BACKPORT_DIR
	string
	default "backports/"

config BACKPORT_VERSION
	string
	default "d13ca80"

config BACKPORT_KERNEL_VERSION
	string
	default "v4.2-rc7-0-g2c6625c"

config BACKPORT_KERNEL_NAME
	string
	default "Linux"

menuconfig BACKPORT_LINUX
	bool "Backport Linux v4.2-rc7-0-g2c6625c (backports d13ca80)"
	default n
	---help---
	  Enabling this will let give you the opportunity to use features and
	  drivers backported from Linux v4.2-rc7-0-g2c6625c
	  on the kernel your are using. This is experimental and you should
	  say no unless you'd like to help test things or want to help debug
	  this should we run into any issues.

if BACKPORT_LINUX

config BACKPORT_KERNEL_3_5
    def_bool y
config BACKPORT_KERNEL_3_6
    def_bool y
config BACKPORT_KERNEL_3_7
    def_bool y
config BACKPORT_KERNEL_3_8
    def_bool y
config BACKPORT_KERNEL_3_9
    def_bool y
config BACKPORT_KERNEL_3_10
    def_bool y
config BACKPORT_KERNEL_3_11
    def_bool y
config BACKPORT_KERNEL_3_12
    def_bool y
config BACKPORT_KERNEL_3_13
    def_bool y
config BACKPORT_KERNEL_3_14
    def_bool y
config BACKPORT_KERNEL_3_15
    def_bool y
config BACKPORT_KERNEL_3_16
    def_bool y
config BACKPORT_KERNEL_3_17
    def_bool y
config BACKPORT_KERNEL_3_18
    def_bool y
config BACKPORT_KERNEL_3_19
    def_bool y
config BACKPORT_KERNEL_4_0
    def_bool y
config BACKPORT_KERNEL_4_1
    def_bool y
config BACKPORT_KERNEL_4_2
    def_bool y

# this has the configuration for the backport code
source "$BACKPORT_DIR/compat/Kconfig"

# these are copied from the kernel
source "$BACKPORT_DIR/net/bluetooth/Kconfig"

source "$BACKPORT_DIR/net/6lowpan/Kconfig"
source "$BACKPORT_DIR/net/ieee802154/Kconfig"
source "$BACKPORT_DIR/net/mac802154/Kconfig"

source "$BACKPORT_DIR/drivers/anbox/Kconfig"

endif # BACKPORT_LINUX
```

## backports/drivers/anbox/Kconfig
```kconfig
menu "Anbox"

config ANBOX
	bool "Anbox Drivers"
	default N
	---help---
	  Enable support for various drivers needed for Anbox

if ANBOX

config ANBOX_BINDER_IPC
	bool "Anbox Binder IPC Driver"
	default n
	
config ANBOX_BINDER_IPC_32BIT
    bool "32bit Anbox binder"
    default n

endif # if ANBOX

endmenu
```

## drivers/char/frandom/Kconfig
```kconfig
config FRANDOM
	tristate "frandom support"
	default m
	---help---
	   Say Y to compile frandom as module.
	   The module will be called frandom.ko.
```

## drivers/media/platform/msm/Kconfig
```kconfig
#
# MSM camera configuration
#

comment "Qualcomm MSM Camera And Video"

menuconfig MSM_CAMERA
	bool "Qualcomm MSM camera and video capture support"
	depends on ARCH_MSM && VIDEO_V4L2 && I2C
	default y
	help
	  Say Y here to enable selecting the video adapters for
	  Qualcomm msm camera and video encoding

config MSM_CAMERA_DEBUG
	bool "Qualcomm MSM camera debugging with printk"
	depends on MSM_CAMERA
	default n
	help
	  Enable printk() debug for msm camera

menuconfig MSMB_CAMERA
	bool "Qualcomm MSM camera and video capture 2.0 support"
	depends on ARCH_MSM && VIDEO_V4L2 && I2C
	---help---
	  Say Y here to enable selecting the video adapters for
	  Qualcomm msm camera and video capture 2.0, enabling this
	  adds support for the camera driver stack including sensor, isp
	  and postprocessing drivers.

config MSMB_CAMERA_DEBUG
	bool "Qualcomm MSM camera 2.0 debugging with printk"
	depends on MSMB_CAMERA
	---help---
	  Enable printk() debug for msm camera 2.0

choice
	prompt "Camera stack variant"
	depends on MSMB_CAMERA && MACH_OPPO
	default MSMB_CAMERA_DEFAULT

config MSMB_CAMERA_DEFAULT
	bool "Default Qualcomm camera stack"

config ONEPLUS_CAMERA
	bool "OnePlus' variant of the camera stack"
	---help---
	  Enable the old OnePlus camera code

config OPPO_CAMERA
	bool "Oppo's variant of the camera stack"
	---help---
	  Enable the old Oppo camera code

endchoice

if MSMB_CAMERA
if ONEPLUS_CAMERA
source "drivers/media/platform/msm/camera_oneplus_v2/Kconfig"
endif
if OPPO_CAMERA
source "drivers/media/platform/msm/camera_oppo_v2/Kconfig"
endif
if MSMB_CAMERA_DEFAULT
source "drivers/media/platform/msm/camera_v2/Kconfig"
endif
endif # MSMB_CAMERA

source "drivers/media/platform/msm/vidc/Kconfig"
source "drivers/media/platform/msm/wfd/Kconfig"
source "drivers/media/platform/msm/dvb/Kconfig"
source "drivers/media/platform/msm/vcap/Kconfig"
```

## drivers/misc/shineled/Kconfig
```kconfig
config SN3193_SLED
	tristate "SN3193 breath led Driver"
	default n
	help
	  Say Y here to enable breath led.
```

## drivers/power/oppo/Kconfig
```kconfig
if MACH_OPPO

config BATTERY_BQ27541_OPPO
	tristate "BQ27541 battery driver"
	depends on I2C
	default n
	help
	  Say Y here to enable support for batteries with BQ27541 (I2C) chips.

config HMAC_SHA1_BQ27541_OPPO
	bool "BQ27541 HMAC SHA1 support"
	depends on BATTERY_BQ27541_OPPO
	help
	  Say Y here to enable support for BQ27541 battery HMAC SHA1 support.

config BQ24196_CHARGER_OPPO
	tristate "BQ24196 Charger driver"
	help
	  Say Y here to enable the BQ24196 battery charger device.

config QPNP_CHARGER_OPPO
	tristate "QPNP Charger driver"
	depends on SPMI
	depends on OF_SPMI
	depends on THERMAL_QPNP_ADC_TM
	help
	  Say Y here to enable the switch mode battery charger
	  and boost device which supports USB detection and charging. The driver
	  also offers relevant information to userspace via the power supply
	  framework.

config PIC1503_FASTCG_OPPO
	tristate "PIC1503 Fast-charge Driver"
	help
	  Say Y here to enable the PIC1503 fast charger

endif
```

## drivers/staging/android/Kconfig
```kconfig
menu "Android"

config ANDROID
	bool "Android Drivers"
	default N
	---help---
	  Enable support for various drivers needed on the Android platform

if ANDROID

config ANDROID_BINDER_IPC
	bool "Android Binder IPC Driver"
	default n

config ANDROID_BINDER_IPC_32BIT
	bool "Use old 32-bit binder api"
	depends on !64BIT
	---help---
	  Enable to support an old 32-bit Android user-space. Breaks the new
	  Android user-space.

config ANDROID_BINDER_DEVICES
	string "Android Binder devices"
	depends on ANDROID_BINDER_IPC
	default "binder"
	---help---
	  Default value for the binder.devices parameter.

	  The binder.devices parameter is a comma-separated list of strings
	  that specifies the names of the binder device nodes that will be
	  created. Each binder device has its own context manager, and is
	  therefore logically separated from the other devices.

config ASHMEM
	bool "Enable the Anonymous Shared Memory Subsystem"
	default n
	depends on SHMEM || TINY_SHMEM
	help
	  The ashmem subsystem is a new shared memory allocator, similar to
	  POSIX SHM but with different behavior and sporting a simpler
	  file-based API.

	  It is, in theory, a good memory allocator for low-memory devices,
	  because it can discard shared memory units when under memory pressure.

config ANDROID_PERSISTENT_RAM
	bool
	depends on HAVE_MEMBLOCK
	select REED_SOLOMON
	select REED_SOLOMON_ENC8
	select REED_SOLOMON_DEC8

config ANDROID_RAM_CONSOLE
	bool "Android RAM buffer console"
	depends on !S390 && !UML && HAVE_MEMBLOCK
	select ANDROID_PERSISTENT_RAM
	default n

config PERSISTENT_TRACER
	bool "Persistent function tracer"
	depends on HAVE_FUNCTION_TRACER
	select FUNCTION_TRACER
	select ANDROID_PERSISTENT_RAM
	help
	  persistent_trace traces function calls into a persistent ram
	  buffer that can be decoded and dumped after reboot through
	  /sys/kernel/debug/persistent_trace.  It can be used to
	  determine what function was last called before a reset or
	  panic.

	  If unsure, say N.

config ANDROID_TIMED_OUTPUT
	bool "Timed output class driver"
	default y

config ANDROID_TIMED_GPIO
	tristate "Android timed gpio driver"
	depends on GENERIC_GPIO && ANDROID_TIMED_OUTPUT
	default n

config ANDROID_LOW_MEMORY_KILLER
	bool "Android Low Memory Killer"
	default N
	---help---
	  Register processes to be killed when memory is low

config ANDROID_LOW_MEMORY_KILLER_AUTODETECT_OOM_ADJ_VALUES
	bool "Android Low Memory Killer: detect oom_adj values"
	depends on ANDROID_LOW_MEMORY_KILLER
	default y
	---help---
	  Detect oom_adj values written to
	  /sys/module/lowmemorykiller/parameters/adj and convert them
	  to oom_score_adj values.

source "drivers/staging/android/switch/Kconfig"

config ANDROID_INTF_ALARM_DEV
	bool "Android alarm driver"
	depends on RTC_CLASS
	default n
	help
	  Provides non-wakeup and rtc backed wakeup alarms based on rtc or
	  elapsed realtime, and a non-wakeup alarm on the monotonic clock.
	  Also exports the alarm interface to user-space.

endif # if ANDROID

endmenu
```

## kernel/time/Kconfig
```kconfig
#
# Timer subsystem related configuration options
#

# Core internal switch. Selected by NO_HZ_COMMON / HIGH_RES_TIMERS. This is
# only related to the tick functionality. Oneshot clockevent devices
# are supported independ of this.
config TICK_ONESHOT
	bool

config NO_HZ_COMMON
	bool
	depends on !ARCH_USES_GETTIMEOFFSET && GENERIC_CLOCKEVENTS
	select TICK_ONESHOT

config NO_HZ
	bool "Tickless System (Dynamic Ticks)"
	depends on !ARCH_USES_GETTIMEOFFSET && GENERIC_CLOCKEVENTS
	select NO_HZ_COMMON
	help
	  This option enables a tickless system: timer interrupts will
	  only trigger on an as-needed basis both when the system is
	  busy and when the system is idle.

config NO_HZ_FULL
	bool "Full dynticks system (tickless single task)"
	# NO_HZ_COMMON dependency
	depends on !ARCH_USES_GETTIMEOFFSET && GENERIC_CLOCKEVENTS
	# RCU_USER_QS
	depends on HAVE_CONTEXT_TRACKING && SMP
	# RCU_NOCB_CPU dependency
	depends on TREE_RCU || TREE_PREEMPT_RCU
	depends on VIRT_CPU_ACCOUNTING_GEN
	select NO_HZ_COMMON
	select RCU_USER_QS
	select RCU_NOCB_CPU
	select CONTEXT_TRACKING_FORCE
	select IRQ_WORK
	help
	 Adaptively try to shutdown the tick whenever possible, even when
	 the CPU is running tasks. Typically this requires running a single
	 task on the CPU. Chances for running tickless are maximized when
	 the task mostly runs in userspace and has few kernel activity.

	 You need to fill up the nohz_full boot parameter with the
	 desired range of dynticks CPUs.

	 This is implemented at the expense of some overhead in user <-> kernel
	 transitions: syscalls, exceptions and interrupts. Even when it's
	 dynamically off.

	 Say N.

config HIGH_RES_TIMERS
	bool "High Resolution Timer Support"
	depends on !ARCH_USES_GETTIMEOFFSET && GENERIC_CLOCKEVENTS
	select TICK_ONESHOT
	help
	  This option enables high resolution timer support. If your
	  hardware is not capable then this option only increases
	  the size of the kernel image.

config GENERIC_CLOCKEVENTS_BUILD
	bool
	default y
	depends on GENERIC_CLOCKEVENTS

config GENERIC_CLOCKEVENTS_MIN_ADJUST
	bool
```
